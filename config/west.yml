## config/west.yml
```yaml
manifest:
  remotes:
    - name: zmkfirmware
      url-base: https://github.com/zmkfirmware
    - name: badjeff
      url-base: https://github.com/badjeff
    - name: bsalex
      url-base: https://github.com/bsalex
    # Additional modules containing boards/shields/custom code can be listed here as well
    # See https://docs.zephyrproject.org/3.2.0/develop/west/manifest.html#projects
  projects:
    - name: zmk
      remote: zmkfirmware
      revision: main
      import: app/west.yml
    - name: zmk-output-behavior-listener
      remote: badjeff
      revision: main
    - name: zmk-drv2605-driver
      remote: bsalex
      revision: main
  self:
    path: config
```
